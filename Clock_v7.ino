#include <WiFi.h>
#include "time.h"
#include <MD_MAX72xx.h>
#include <Preferences.h>
#include <Arduino.h>
#include <SPI.h>
#include <Wire.h>
#include "time.h"
#include "RTClib.h"

#define HARDWARE_TYPE MD_MAX72XX::FC16_HW
#define MAX_DEVICES  24

#define CLK_PIN   18  // or SCK
#define DATA_PIN  23  // or MOSI
#define CS_PIN    5  // or SS
#define DATE_PIN 12
#define MONTH_PIN 15

// SPI hardware interface
MD_MAX72XX mx = MD_MAX72XX(HARDWARE_TYPE, CS_PIN, MAX_DEVICES);

Preferences preferences;

RTC_DS3231 rtc;


#define LED 2
#define WIFI_SSID "Kundu"
#define WIFI_PASS "alupotolbegun"
#define WIFI_TOUT 10000

#define NTP_SERVER "pool.ntp.org"
#define UTC_OFFSET 21600
#define UTC_OFFSET_DST 0


struct tm WifitimeGet();
void SyncClockStart();


//Necessary sign
uint16_t colon[] = {0x00, 0x00, 0x00, 0x00, 0x00, 0x00, 0x30, 0x0c, 0x30, 0x0c, 0x00, 0x00};
uint16_t gap[] = {0x00, 0x00};
uint16_t yearmondate[3];
uint16_t pattern1[128];
//uint8_t pattern2[300];
uint8_t pattern3[60];
uint8_t pattern4[128];
uint16_t sec;
uint16_t minu;
uint16_t hour;
uint16_t minu_digit[2];
uint16_t hour_digit[2];
uint16_t year_digit[4];
uint16_t year_digit_bangla[4];

uint16_t eng_month_digit[2];
uint16_t eng_date_digit[2];
uint16_t bang_date_digit[2];
uint16_t minu2;

// Push button Control
int count_Date = 0;
int count_Month = 0;
unsigned long button_time = 0;
unsigned long last_button_time = 0;
unsigned long debouncedelay = 500;

// Hizri variables

int date4 = 1;
int month4 = 1;
int year3 = 1444;

//Software Interrupt

hw_timer_t *My_timer = NULL;

//All numbers needed/////////////////////////////////////////////////////////////////////////////////////////////////////////////////////////////////////////////////////////////

uint8_t all_num[10][26] = {{0x00, 0x00, 0x80, 0x03, 0xe0, 0x0f, 0xf0, 0x0f, 0x30, 0x1c, 0x18, 0x18, 0x18, 0x18, 0x38, 0x1c, 0x70, 0x0e, 0xe0, 0x07, 0xc0, 0x03, 0x00, 0x00, 0x00, 0x00},
  {0x00, 0x00, 0x0c, 0x00, 0x1e, 0x30, 0x7e, 0x78, 0xf0, 0x78, 0xe0, 0x79, 0xc0, 0x3f, 0x80, 0x1f, 0x00, 0x0f, 0x00, 0x00, 0x00, 0x00, 0x00, 0x00, 0x00, 0x00},
  {0x00, 0x00, 0x04, 0x04, 0x0e, 0x04, 0x1a, 0x0e, 0x30, 0x0e, 0x20, 0x1a, 0x60, 0x13, 0x40, 0x31, 0xc0, 0x21, 0x80, 0x60, 0x00, 0x40, 0x00, 0x00, 0x00, 0x00},
  {0x3c, 0x00, 0xe0, 0x00, 0x80, 0x03, 0x00, 0x0e, 0x00, 0x18, 0x00, 0x30, 0x04, 0x20, 0x0e, 0x20, 0x0a, 0x30, 0x02, 0x18, 0x06, 0x0e, 0x9c, 0x03, 0x70, 0x00},
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  {0x00, 0x00, 0x1c, 0x0e, 0x10, 0x0b, 0x30, 0x01, 0x20, 0x01, 0x20, 0x23, 0x20, 0x3e, 0x60, 0x30, 0xc0, 0x18, 0x80, 0x0f, 0x00, 0x00, 0x00, 0x00, 0x00, 0x00}
};


uint8_t all_bang_months[12][128] = {{0x02, 0x00, 0x06, 0x07, 0xe4, 0x1f, 0xf4, 0x33, 0x3c, 0x38, 0x38, 0x18, 0x30,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 0x00, 0x00},
  {0x06, 0x07, 0xe4, 0x1f, 0x74, 0x30, 0x3c, 0x38, 0x38, 0x18, 0xb0, 0x03, 0x30,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 0x00, 0x00},
  {0x30, 0x00, 0xb0, 0x07, 0x30, 0x1e, 0x30, 0x18, 0x30, 0x31, 0xb0, 0x33, 0xf0,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 0x00, 0x00},
  {0x30, 0x18, 0x30, 0x38, 0xb0, 0x61, 0xa0, 0x63, 0xc0, 0x21, 0xa0, 0x23, 0xb0,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 0x00, 0x00},
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  {0x00, 0x00, 0x00, 0x00, 0x12, 0x00, 0x16, 0x00, 0x14, 0x0f, 0xd4, 0x19, 0x54,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 0x00, 0x00}
};

//uint8_t all_hijri_months[12][192] = {{0x00, 0x00, 0x04, 0x00, 0x84, 0x07, 0x8c, 0x04, 0xfc, 0x07, 0x84, 0x00, 0x84,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 0x00, 0x00},
//{0x00, 0x00, 0x04, 0x18, 0x04, 0x0c, 0x04, 0x06, 0xfc, 0x07, 0x04, 0x02, 0x04,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 0x00, 0x00},
//{0x04, 0x01, 0x84, 0x23, 0xc4, 0x06, 0x64, 0x0c, 0x34, 0x18, 0x1c, 0x30, 0xfc,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 0x00, 0x00},
//{0x04, 0x01, 0x84, 0x23, 0xc4, 0x06, 0x64, 0x0c, 0x34, 0x18, 0x1c, 0x30, 0xfc,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 0x00, 0x00},
//{0xfc, 0x1f, 0x04, 0x10, 0x04, 0x10, 0x04, 0x10, 0x04, 0x10, 0xfc, 0x10, 0xa4,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 0xfc, 0x7f},
//{0xfc, 0x1f, 0x04, 0x10, 0x04, 0x10, 0x04, 0x10, 0x04, 0x10, 0xfc, 0x10, 0xa4,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 0x00, 0x00},
//{0x00, 0x00, 0x04, 0x00, 0x04, 0x03, 0x84, 0x26, 0xc4, 0x0c, 0x64, 0x08, 0x34,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 0x00, 0x00},
//{0x00, 0x00, 0x00, 0x00, 0xe4, 0x00, 0xe4, 0x00, 0xe4, 0x00, 0x7c, 0x00, 0x70,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 0x00, 0x00},
//{0x04, 0x00, 0x04, 0x03, 0x84, 0x27, 0xe4, 0x0c, 0x34, 0x18, 0x1c, 0x30, 0x0c,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 0x00, 0x00},
//{0x00, 0x00, 0x00, 0x00, 0x00, 0x00, 0x08, 0x00, 0x0c, 0x00, 0x0c, 0x1c, 0x0c,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 0x00, 0x00},
//{0x00, 0x00, 0x04, 0x00, 0xff, 0x3f, 0x05, 0x00, 0x05, 0x00, 0xfd, 0x3f, 0x05,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 0x00, 0x00},
//{0x00, 0x00, 0x04, 0x00, 0xff, 0x3f, 0x05, 0x00, 0x05, 0x00, 0xfd, 0x3f, 0x05,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 0x00, 0x00}};

uint8_t all_hijri_months[12][192] = {{0x00, 0x00, 0x04, 0x00, 0x84, 0x07, 0x8c, 0x04, 0xfc, 0x07, 0x84, 0x00, 0x84,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 0x00, 0x00},
  {0x00, 0x00, 0x04, 0x18, 0x04, 0x0c, 0x04, 0x06, 0xfc, 0x07, 0x04, 0x02, 0x04,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 0x00, 0x00},
  {0x04, 0x01, 0x84, 0x23, 0xc4, 0x06, 0x64, 0x0c, 0x34, 0x18, 0x1c, 0x30, 0xfc,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 0x00, 0x00},
  {0x04, 0x01, 0x84, 0x23, 0xc4, 0x06, 0x64, 0x0c, 0x34, 0x18, 0x1c, 0x30, 0xfc,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 0x00, 0x00},
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  {0x00, 0x00, 0x04, 0x00, 0xff, 0x3f, 0x05, 0x00, 0x05, 0x00, 0xfd, 0x3f, 0x05,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 0x00, 0x00}
};



//uint8_t pattern_hyphen[64]={0x00, 0x00, 0x80, 0x01, 0x80, 0x01, 0x80, 0x01, 0x80, 0x01, 0x80, 0x01, 0x80,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 0x00, 0x00};

uint8_t all_eng_months[12][128] = {{0x00, 0x00, 0xc8, 0x00, 0x88, 0x03, 0x08, 0x06, 0x08, 0x0c, 0x68, 0x08, 0xa8,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 0x00, 0x00},
  {0x00, 0x00, 0x10, 0x1f, 0xd0, 0x31, 0x50, 0x60, 0x30, 0x40, 0x30, 0x60, 0x10,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 0x00, 0x00},
  {0x00, 0x00, 0x30, 0x00, 0x30, 0x00, 0x30, 0x04, 0x70, 0x0e, 0xf0, 0x0f, 0x30,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 0x00, 0x00},
  {0x00, 0x0c, 0x00, 0x1e, 0x60, 0x18, 0xf0, 0x18, 0xf0, 0x18, 0x70, 0x08, 0x10,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 0x00, 0x00},
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  {0x30, 0x00, 0xfc, 0x3f, 0xf6, 0x3f, 0x33, 0x00, 0x33, 0x0f, 0x33, 0x1f, 0x33,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 0x00, 0x00}
};

uint8_t all_bang_prohors[8][192] = {{0x30, 0x07, 0x30, 0x0e, 0x30, 0x48, 0xf0, 0xa8, 0xf0, 0x98, 0x70, 0x98, 0xf0,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 0x00, 0x00},
  {0x30, 0x00, 0x30, 0x1f, 0x36, 0x20, 0xb6, 0x2f, 0x34, 0x38, 0x34, 0x30, 0xf4,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 0x00, 0x00},
  {0xc0, 0x00, 0xe0, 0x04, 0x30, 0x67, 0x30, 0xf6, 0x30, 0x92, 0xe0, 0x91, 0xc0,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 0x00, 0x00},
  {0x70, 0x00, 0x70, 0x0c, 0x70, 0x0c, 0xb0, 0x0b, 0x30, 0x18, 0x30, 0x10, 0xf0,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 0x00, 0x00},
  {0xf0, 0x07, 0x30, 0x0c, 0x30, 0x18, 0xb0, 0x33, 0xf0, 0x22, 0x70, 0x20, 0x70,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 0x00, 0x00},
  {0x30, 0x30, 0x70, 0x20, 0x70, 0x10, 0xf0, 0x0f, 0x30, 0x08, 0x30, 0x30, 0x30,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 0x00, 0x00},
  {0xc0, 0x10, 0xe0, 0x64, 0x30, 0x47, 0x30, 0x66, 0x30, 0x22, 0xe0, 0x11, 0xc0,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 0x00, 0x00},
  {0x30, 0x00, 0xfe, 0x3f, 0x32, 0x00, 0x32, 0x1e, 0x36, 0x12, 0x34, 0x02, 0x34,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 0x00, 0x00}
};

uint8_t pattern_slash[64] = {0x00, 0x00, 0x00, 0x00, 0x00, 0x70, 0x00, 0x1c, 0x00, 0x07, 0xc0, 0x01, 0x70,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 0x00, 0x00};

int all_eng_months_len[] = {128, 128, 64, 90, 40, 64, 90, 92, 128, 128, 128, 128};
int all_num_len[] = {24, 24, 28, 32, 26, 28, 28, 24, 28, 28};
int all_prohor_len[] = {96, 78, 94, 104, 120, 104, 86, 94};
int all_bang_months_len[] = {78, 64, 86, 72, 52, 90, 94, 128, 64, 64, 66, 64};
int slash_len = 20;
//int hyphen_len = 26;
////////////////////////////////////////////////////////////////////////////////////////////////////////////////////////////////////////////////////////////////////////////////////
int all_hijri_months_len[] = {128, 64, 192, 160, 192, 176, 64, 80, 128, 128, 128, 128};



//To Do
//All months needed (ENG)
//All months needed (Beng)
//All parts of day
//All momths needed (Arab)

//Hijri functions

static const long IslamicEpoch = 227014; // Absolute date of start of Islamic calendar

static int lastDayOfGregorianMonth( int month, int year )
{
  // Compute the last date of the month for the Gregorian calendar.

  switch ( month ) {
    case 2:
      if ( ( ( ( year % 4 ) == 0 ) && ( ( year % 100 ) != 0 ) )
           || ( ( year % 400 ) == 0 ) ) {
        return 29;
      } else {
        return 28;
      }
    case 4:
    case 6:
    case 9:
    case 11: return 30;
    default: return 31;
  }
}


class GregorianDate
{
  private:
    long year;   // 1...
    int month;  // 1 == January, ..., 12 == December
    int day;    // 1..lastDayOfGregorianMonth(month, year)


  public:
    GregorianDate( int m, int d, int y )
    {
      month = m; day = d; year = y;

    }

    // Computes the Gregorian date from the absolute date.
    GregorianDate( long d )
    {
      // Search forward year by year from approximate year
      year = d / 366;
      while ( d >= GregorianDate( 1, 1, year + 1 ) ) {
        year++;
      }
      // Search forward month by month from January
      month = 1;
      while ( d > GregorianDate( month, lastDayOfGregorianMonth( month, year ), year ) ) {
        month++;
      }
      day = d - GregorianDate( month, 1, year ) + 1;
    }

    // Computes the absolute date from the Gregorian date.
    operator long ()
    {
      int N = day;           // days this month
      for ( int m = month - 1;  m > 0; m-- ) // days in prior months this year
        N = N + lastDayOfGregorianMonth( m, year );
      return
        ( N                    // days this year
          + 365 * ( year - 1 )   // days in previous years ignoring leap days
          + ( year - 1 ) / 4       // Julian leap days before this year...
          - ( year - 1 ) / 100     // ...minus prior century years...
          + ( year - 1 ) / 400 );   // ...plus prior years divisible by 400
    }

    int getMonth()
    {
      return month;
    }

    int getDay()
    {
      return day;
    }

    int getYear()
    {
      return year;
    }

};



static int IslamicLeapYear( int year )
{
  // True if year is an Islamic leap year

  if ( ( ( ( 11 * year ) + 14 ) % 30 ) < 11 ) {
    return 1;
  } else {
    return 0;
  }
}


static int lastDayOfIslamicMonth( int month, int year )
{
  // Last day in month during year on the Islamic calendar.

  if ( ( ( month % 2 ) == 1 ) || ( ( month == 12 ) && IslamicLeapYear( year ) ) ) {
    return 30;
  } else {
    return 29;
  }
}


class IslamicDate
{
  private:
    long year;   // 1...
    int month;  // 1..13 (12 in a comonthon year)
    int day;    // 1..lastDayOfIslamicMonth(month,year)

  public:
    IslamicDate( int m, int d, int y )
    {
      month = m; day = d; year = y;
    }

    // Computes the Islamic date from the absolute date.
    IslamicDate( long  d )
    {
      if ( d <= IslamicEpoch ) { // Date is pre-Islamic
        month = 0;
        day = 0;
        year = 0;
      } else {
        // Search forward year by year from approximate year
        year = ( d - IslamicEpoch ) / 355;
        while ( d >= IslamicDate( 1, 1, year + 1 ) ) {
          year++;
        }
        // Search forward month by month from Muharram
        month = 1;
        while ( d > IslamicDate( month, lastDayOfIslamicMonth( month, year ), year ) ) {
          month++;
        }
        day = d - IslamicDate( month, 1, year ) + 1;
      }
    }


    // Computes the absolute date from the Islamic date.
    operator long()
    {
      return ( day                          // days so far this month
               + 29 * ( month - 1 )         // days so far...
               + month / 2                  //            ...this year
               + 354 * ( year - 1 )         // non-leap days in prior years
               + ( 3 + ( 11 * year ) ) / 30 // leap days in prior years
               + IslamicEpoch );            // days before start of calendar
    }

    int getMonth()
    {
      return month;
    }

    int getDay()
    {
      return day;
    }

    int getYear()
    {
      return year;
    }

};


static void gregorianToHijri(int  & month, int  &day, int  &year )
{

  GregorianDate gregorian( month, day , year );
  long  absolute = gregorian;
  IslamicDate islamic( absolute );
  year =  islamic.getYear();
  month = islamic.getMonth();
  day = islamic.getDay();
}







// Wifi
void connectToWiFi() {

  Serial.print("Connecting to WiFi");
  WiFi.mode(WIFI_STA);
  WiFi.begin(WIFI_SSID, WIFI_PASS);

  unsigned long startAttemptTime = millis();
  while ((WiFi.status() != WL_CONNECTED) && (millis() - startAttemptTime < WIFI_TOUT))
  {
    Serial.print(".");
    delay(100);
  }

  if (WiFi.status() != WL_CONNECTED)
  {
    Serial.println("Failed!");
    //digitalWrite(LED, LOW);
  }
  else
  {
    Serial.println("Connected!");
    Serial.println(WiFi.localIP());
    //digitalWrite(LED, HIGH);
  }
}

//void printLocalTime() {
//  struct tm timeinfo;
//  if (!getLocalTime(&timeinfo)) {
//    Serial.println("Connection Err");
//    return;
//  }
//
//  Serial.println(&timeinfo, "%H:%M:%S");
//  Serial.println(&timeinfo, "%d/%m/%Y   %Z");
//}



void TmStp() {
  DateTime time = rtc.now();

  //Full Timestamp
  Serial.println(String("DateTime::TIMESTAMP_FULL:\t") + time.timestamp(DateTime::TIMESTAMP_FULL));

  //Date Only
  //Serial.println(String("DateTime::TIMESTAMP_DATE:\t") + time.timestamp(DateTime::TIMESTAMP_DATE));

  //Full Timestamp
  //Serial.println(String("DateTime::TIMESTAMP_TIME:\t") + time.timestamp(DateTime::TIMESTAMP_TIME));

  //Serial.println("\n");

}

void IRAM_ATTR upcount_date() {
  //delay(1);
  button_time = millis();
  if (button_time - last_button_time > debouncedelay)
  {
    //delay(500);
    if ((count_Date + date4) < 30)
      count_Date++;
    else
      count_Date = 1 - date4;

    preferences.begin("hijri_count", false);
    preferences.putInt("count_Date", count_Date);
    preferences.end();

    Serial.println(count_Date);
    Serial.println(date4);
    Serial.println(date4 + count_Date);
    last_button_time = button_time;

  }
}

void IRAM_ATTR upcount_month() {
  //delay(1);
  button_time = millis();
  if (button_time - last_button_time > debouncedelay)
  {
    //delay(500);

    if ((count_Month + month4) < 12)
      count_Month++;
    else
      count_Month = 1 - month4;

    preferences.begin("hijri_count", false);
    preferences.putInt("count_Month", count_Month);
    preferences.end();

    Serial.println(count_Month);
    Serial.println(month4);
    Serial.println(month4 + count_Month);

    last_button_time = button_time;

  }
}

void IRAM_ATTR syncTimer() {
  SyncClockStart();
  Serial.println("Hello World");
}


void setup() {

  // put your setup code here, to run once:
  Serial.begin(115200);

  // memory read
  preferences.begin("hijri_count", false);
  count_Date = preferences.getInt("count_Date", 0);
  count_Month = preferences.getInt("count_Month", 0);
  preferences.end();

  //Pin initialization
  pinMode(LED, OUTPUT);
  pinMode(DATE_PIN, INPUT_PULLUP);
  pinMode(MONTH_PIN, INPUT_PULLUP);

  //HW interrupt
  attachInterrupt(DATE_PIN, upcount_date, FALLING);
  attachInterrupt(MONTH_PIN, upcount_month, FALLING);

  //SW interrupt
  My_timer = timerBegin(0, 16000, true);  //5kHz
  timerAttachInterrupt(My_timer, &syncTimer, true);
  timerAlarmWrite(My_timer,108000000,true); //6 hrs  //108000000   //300000
  timerAlarmEnable(My_timer); //Just Enable

  //Init Wifi and get time 
  SyncClockStart();

  //Init LED Matrix
  mx.begin();

}



struct tm WifitimeGet() {
  connectToWiFi();
  configTime(UTC_OFFSET, UTC_OFFSET_DST, NTP_SERVER);

  struct tm timeinfo;
  if (!getLocalTime(&timeinfo)) {
    Serial.println("Connection Err");
    WiFi.disconnect();

  }

  //Serial.println(&timeinfo, "%H:%M:%S");
  //Serial.println(&timeinfo, "%d/%m/%Y   %Z");

  //WiFi.disconnect();
  return timeinfo;
}

void SyncClockStart() {
  struct tm timeinfo;
  timeinfo = WifitimeGet();

  if (! rtc.begin()) {
    Serial.println("Couldn't find RTC");
    Serial.flush();
    //while (1) delay(10);
  }

  if (rtc.lostPower() && (WiFi.status() == WL_CONNECTED)) {
    Serial.println("RTC is NOT running, let's set the time!");
    rtc.adjust(DateTime(timeinfo.tm_year, timeinfo.tm_mon, timeinfo.tm_mday, timeinfo.tm_hour, timeinfo.tm_min, timeinfo.tm_sec));
  }

  WiFi.disconnect();
}
void show_led_time()
{

  DateTime time = rtc.now();
  sec = time.second();
  minu = time.minute();
  hour = time.hour();
  if (hour == 12)
  {
    hour = 12;
  }
  else if (hour == 0)
  {
    hour = 12;
  }
  else
  {
    hour = hour % 12;
  }
  if (minu == minu2)
  {
    return;
  }
  else
  {
    minu_digit[0] = minu / 10;
    minu_digit[1] = minu % 10;

    hour_digit[0] = hour / 10;
    hour_digit[1] = hour % 10;
    //Serial.println(minu);
    //delay(5000);
    int p;
    for (p = 0; p < 128; p++)
      pattern1[p] = 0x00;

    int n;

    for (n == 0; n < 26; n++) {
      pattern1[n + 2] = all_num[hour_digit[0]][n];
      pattern1[n + 32] = all_num[hour_digit[1]][n];

      if (n < 12)
        pattern1[n + 58] = colon[n];

      pattern1[n + 70] = all_num[minu_digit[0]][n];
      pattern1[n + 100] = all_num[minu_digit[1]][n];

    }
    int len1 = sizeof(pattern1) / sizeof(pattern1[0]);
    for (int i = 0; i < len1 / 2; i++)
    {
      mx.setColumn(63 - i, pattern1[2 * i]);
      mx.setColumn(127 - i, pattern1[2 * i + 1]);
    }

    for (int j = 0; j < 64 - len1 / 2; j++)
    {
      mx.setColumn(63 - len1 / 2 - j, 0x00);
      mx.setColumn(127 - len1 / 2 - j, 0x00);
    }
    minu2 = minu;
  }


}
void show_led_time2()
{

  DateTime time = rtc.now();
  sec = time.second();
  minu = time.minute();
  hour = time.hour();
  if (hour == 12)
  {
    hour = 12;
  }
  else if (hour == 0)
  {
    hour = 12;
  }
  else
  {
    hour = hour % 12;
  }



  minu_digit[0] = minu / 10;
  minu_digit[1] = minu % 10;

  hour_digit[0] = hour / 10;
  hour_digit[1] = hour % 10;
  //Serial.println(minu);
  //delay(5000);
  int p;
  for (p = 0; p < 128; p++)
    pattern1[p] = 0x00;

  int n;

  for (n = 0; n < 26; n++) {
    pattern1[n + 2] = all_num[hour_digit[0]][n];
    pattern1[n + 32] = all_num[hour_digit[1]][n];

    if (n < 12)
      pattern1[n + 58] = colon[n];

    pattern1[n + 70] = all_num[minu_digit[0]][n];
    pattern1[n + 100] = all_num[minu_digit[1]][n];

  }
  int len1 = sizeof(pattern1) / sizeof(pattern1[0]);
  for (int i = 0; i < len1 / 2; i++)
  {
    mx.setColumn(63 - i, pattern1[2 * i]);
    mx.setColumn(127 - i, pattern1[2 * i + 1]);
  }

  for (int j = 0; j < 64 - len1 / 2; j++)
  {
    mx.setColumn(63 - len1 / 2 - j, 0x00);
    mx.setColumn(127 - len1 / 2 - j, 0x00);
  }



}

void map_bangdate_to_engdate(uint16_t year2, uint16_t month2, uint16_t date2)
{


  if (month2 >= 4 && month2 <= 12)
  {
    year2 = year2 - 593;
  }
  else
  {
    year2 = year2 - 1 - 593;
  }

  if (month2 == 4)
  {

    if (date2 < 14)
    {
      month2 = 12;
      date2 = date2 + 14 + 3;
    }
    else if (date2 >= 14)
    {
      month2 = 1;
      date2 = date2 - 14 + 1;
    }

  }
  else if (month2 == 5)
  {

    if (date2 < 15)
    {
      month2 = 1;
      date2 = date2 + 15 + 2;
    }
    else if (date2 >= 15)
    {
      month2 = 2;
      date2 = date2 - 15 + 1;
    }

  }
  else if (month2 == 6)
  {

    if (date2 < 15)
    {
      month2 = 2;
      date2 = date2 + 15 + 2;
    }
    else if (date2 >= 15)
    {
      month2 = 3;
      date2 = date2 - 15 + 1;
    }
  }
  else if (month2 == 7)
  {

    if (date2 < 16)
    {
      month2 = 3;
      date2 = date2 + 16;
    }
    else if (date2 >= 16)
    {
      month2 = 4;
      date2 = date2 - 16 + 1;
    }
  }
  else if (month2 == 8)
  {

    if (date2 < 16)
    {
      month2 = 4;
      date2 = date2 + 16;
    }
    else if (date2 >= 16)
    {
      month2 = 5;
      date2 = date2 - 16 + 1;
    }
  }
  else if (month2 == 9)
  {

    if (date2 < 16)
    {
      month2 = 5;
      date2 = date2 + 16;
    }
    else if (date2 >= 16)
    {
      month2 = 6;
      date2 = date2 - 16 + 1;
    }
  }
  else if (month2 == 10)
  {

    if (date2 < 16)
    {
      month2 = 6;
      date2 = date2 + 15;
    }
    else if (date2 >= 16)
    {
      month2 = 7;
      date2 = date2 - 16 + 1;
    }
  }
  else if (month2 == 11)
  {

    if (date2 < 15)
    {
      month2 = 7;
      date2 = date2 + 15 + 1;
    }
    else if (date2 >= 15)
    {
      month2 = 8;
      date2 = date2 - 15 + 1;
    }

  }
  else if (month2 == 12)
  {

    if (date2 < 15)
    {
      month2 = 8;
      date2 = date2 + 15 + 1;
    }
    else if (date2 >= 15)
    {
      month2 = 9;
      date2 = date2 - 15 + 1;
    }
  }
  else if (month2 == 1)
  {

    if (date2 < 14)
    {
      month2 = 9;
      date2 = date2 + 14 + 3;
    }
    else if (date2 >= 14)
    {
      month2 = 10;
      date2 = date2 - 14 + 1;
    }

  }
  else if (month2 == 2)
  {

    if (date2 < 13)
    {
      month2 = 10;

      date2 = date2 + 13 + 5;
    }
    else if (date2 >= 13)
    {
      month2 = 11;

      date2 = date2 - 13 + 1;
    }
  }
  else if (month2 == 3)
  {

    if (date2 < 15)
    {
      month2 = 11;

      date2 = date2 + 15 + 2;
    }
    else if (date2 >= 15)
    {
      month2 = 12;

      date2 = date2 - 15 + 1;
    }
  }
  yearmondate[0] = year2;
  yearmondate[1] = month2;
  yearmondate[2] = date2;



}



void loop() {

  TmStp();



  DateTime time = rtc.now();
  //Serial.println(time.minute());
  //delay(5000);
  uint16_t date = time.day();
  uint16_t month = time.month() + 1;
  uint16_t year = time.year() - 100;
  uint16_t hour = time.hour();
  uint16_t year2;
  uint16_t month2;
  uint16_t date2;

  int a = date;
  int b = month;
  int c = year;

  //Serial.println(a);
  //Serial.println(b);
  //Serial.println(c);

  gregorianToHijri(b, a, c);

  Serial.println(a);
  Serial.println(b);
  Serial.println(c);

  date4 = a;
  month4 = b;
  year3 = c;

  int date3 = date4 + count_Date;
  int month3 = month4 + count_Month;

  uint16_t prohor = (hour >= 0 & hour < 3) ? 0 : ((hour >= 3 & hour < 6) ? 1 : ((hour >= 6 & hour < 9) ? 2 : ((hour >= 9 & hour < 12) ? 3 : ((hour >= 12 & hour < 15) ? 4 : ((hour >= 15 & hour < 18) ? 5 : ((hour >= 18 & hour < 21) ? 6 : 7))))));

  minu2 = time.minute();
  show_led_time2();

  //hour = hour%12;


  map_bangdate_to_engdate(year, month, date);
  year2 = yearmondate[0];
  month2 = yearmondate[1];
  date2 = yearmondate[2];



  int ik;
  int jk = 0;


  //eng_month_digit[0] = month / 10;
  //eng_month_digit[1] = month % 10;

  eng_date_digit[0] = date / 10;
  eng_date_digit[1] = date % 10;

  bang_date_digit[0] = date2 / 10;
  bang_date_digit[1] = date2 % 10;

  year_digit[3] = year % 10;
  year = year / 10;
  year_digit[2] = year % 10;
  year = year / 10;
  year_digit[1] = year % 10;
  year = year / 10;
  year_digit[0] = year % 10;

  year_digit_bangla[3] = year2 % 10;
  year2 = year2 / 10;
  year_digit_bangla[2] = year2 % 10;
  year2 = year2 / 10;
  year_digit_bangla[1] = year2 % 10;
  year2 = year2 / 10;
  year_digit_bangla[0] = year2 % 10;
  /*year3 = 1231;
    year_digit_hijri[3] = year3 % 10;
    year2 = year2 / 10;
    year_digit_hijri[2] = year3 % 10;
    year2 = year2 / 10;
    year_digit_hijri[1] = year3 % 10;
    year2 = year2 / 10;
    year_digit_hijri[0] = year3 % 10;
  */






  int hijri_date_digit[2];
  hijri_date_digit[0] = date3 / 10;
  hijri_date_digit[1] = date3 % 10;

  int year_digit_hijri[4];
  year_digit_hijri[3] = year3 % 10;
  year3 = year3 / 10;
  year_digit_hijri[2] = year3 % 10;
  year3 = year3 / 10;
  year_digit_hijri[1] = year3 % 10;
  year3 = year3 / 10;
  year_digit_hijri[0] = year3 % 10;  


  int pattern2_len;
  /*int all_eng_months_len[] ={128,128,64,90,40,64,90,92,128,128,128,128};
    int all_num_len[] ={24,20,24,30,24,28,26,20,24,22};
    int all_prohor_len[] ={128,128,128,128,128,128,128,128};
    int all_bang_months_len[] ={128,128,128,128,128,128,128,128,128,128,128,128};*/
  pattern2_len = 2 + all_prohor_len[prohor] + 2 + all_num_len[eng_date_digit[0]] + 2 + all_num_len[eng_date_digit[1]] + 2 + all_eng_months_len[month - 1] + 2 + all_num_len[year_digit[0]] + all_num_len[year_digit[1]] + all_num_len[year_digit[2]] + all_num_len[year_digit[3]] + 20 + all_num_len[bang_date_digit[0]] + 2 + all_num_len[bang_date_digit[1]] + 2 + all_bang_months_len[month2 - 1] + 2 + all_num_len[year_digit_bangla[0]] + all_num_len[year_digit_bangla[1]] + all_num_len[year_digit_bangla[2]] + all_num_len[year_digit_bangla[3]] + 2 + slash_len + 2 + all_hijri_months_len[month3 - 1] + 4 + all_num_len[hijri_date_digit[0]] + all_num_len[hijri_date_digit[0]] + 2 + slash_len + 2 + all_num_len[year_digit_hijri[3]] + all_num_len[year_digit_hijri[2]] + all_num_len[year_digit_hijri[1]] + all_num_len[year_digit_hijri[0]]+14;

  uint8_t pattern2[pattern2_len];
  //int month3=3;
  int p;
  for (p = 0; p < pattern2_len; p++)
    pattern2[p] = 0x00;

  for (p = 0; p < 192; p++) {

    if (p < 26) {
      pattern2[p + 2 + 2 + all_prohor_len[prohor] + 2] = all_num[eng_date_digit[0]][p];
      pattern2[p + 2 + 2 + all_prohor_len[prohor] + 2 + all_num_len[eng_date_digit[0]] + 2] = all_num[eng_date_digit[1]][p];

      pattern2[p + 2 + 2 + all_prohor_len[prohor] + 2 + all_num_len[eng_date_digit[0]] + 2 + all_num_len[eng_date_digit[1]] + 2 + all_eng_months_len[month - 1] + 2 + all_num_len[year_digit[0]] + all_num_len[year_digit[1]] + all_num_len[year_digit[2]] + all_num_len[year_digit[3]] + 20] = all_num[bang_date_digit[0]][p];
      pattern2[p + 2 + 2 + all_prohor_len[prohor] + 2 + all_num_len[eng_date_digit[0]] + 2 + all_num_len[eng_date_digit[1]] + 2 + all_eng_months_len[month - 1] + 2 + all_num_len[year_digit[0]] + all_num_len[year_digit[1]] + all_num_len[year_digit[2]] + all_num_len[year_digit[3]] + 20 + all_num_len[bang_date_digit[0]] + 2] = all_num[bang_date_digit[1]][p];

      pattern2[p + 2 + 2 + all_prohor_len[prohor] + 2 + all_num_len[eng_date_digit[0]] + 2 + all_num_len[eng_date_digit[1]] + 2 + all_eng_months_len[month - 1] + 2] = all_num[year_digit[0]][p];
      pattern2[p + 2 + 2 + all_prohor_len[prohor] + 2 + all_num_len[eng_date_digit[0]] + 2 + all_num_len[eng_date_digit[1]] + 2 + all_eng_months_len[month - 1] + 2 + all_num_len[year_digit[0]]] = all_num[year_digit[1]][p];
      pattern2[p + 2 + 2 + all_prohor_len[prohor] + 2 + all_num_len[eng_date_digit[0]] + 2 + all_num_len[eng_date_digit[1]] + 2 + all_eng_months_len[month - 1] + 2 + all_num_len[year_digit[0]] + all_num_len[year_digit[1]]] = all_num[year_digit[2]][p];
      pattern2[p + 2 + 2 + all_prohor_len[prohor] + 2 + all_num_len[eng_date_digit[0]] + 2 + all_num_len[eng_date_digit[1]] + 2 + all_eng_months_len[month - 1] + 2 + all_num_len[year_digit[0]] + all_num_len[year_digit[1]] + all_num_len[year_digit[2]]] = all_num[year_digit[3]][p];



      pattern2[p + 2 + 2 + all_prohor_len[prohor] + 2 + all_num_len[eng_date_digit[0]] + 2 + all_num_len[eng_date_digit[1]] + 2 + all_eng_months_len[month - 1] + 2 + all_num_len[year_digit[0]] + all_num_len[year_digit[1]] + all_num_len[year_digit[2]] + all_num_len[year_digit[3]] + 20 + all_num_len[bang_date_digit[0]] + 2 + all_num_len[bang_date_digit[1]] + 2 + all_bang_months_len[month2 - 1] + 2] = all_num[year_digit_bangla[0]][p];
      pattern2[p + 2 + 2 + all_prohor_len[prohor] + 2 + all_num_len[eng_date_digit[0]] + 2 + all_num_len[eng_date_digit[1]] + 2 + all_eng_months_len[month - 1] + 2 + all_num_len[year_digit[0]] + all_num_len[year_digit[1]] + all_num_len[year_digit[2]] + all_num_len[year_digit[3]] + 20 + all_num_len[bang_date_digit[0]] + 2 + all_num_len[bang_date_digit[1]] + 2 + all_bang_months_len[month2 - 1] + 2 + all_num_len[year_digit_bangla[0]] + 2] = all_num[year_digit_bangla[1]][p];
      pattern2[p + 2 + 2 + all_prohor_len[prohor] + 2 + all_num_len[eng_date_digit[0]] + 2 + all_num_len[eng_date_digit[1]] + 2 + all_eng_months_len[month - 1] + 2 + all_num_len[year_digit[0]] + all_num_len[year_digit[1]] + all_num_len[year_digit[2]] + all_num_len[year_digit[3]] + 20 + all_num_len[bang_date_digit[0]] + 2 + all_num_len[bang_date_digit[1]] + 2 + all_bang_months_len[month2 - 1] + 2 + all_num_len[year_digit_bangla[0]] + all_num_len[year_digit_bangla[1]] + 2] = all_num[year_digit_bangla[2]][p];
      pattern2[p + 2 + 2 + all_prohor_len[prohor] + 2 + all_num_len[eng_date_digit[0]] + 2 + all_num_len[eng_date_digit[1]] + 2 + all_eng_months_len[month - 1] + 2 + all_num_len[year_digit[0]] + all_num_len[year_digit[1]] + all_num_len[year_digit[2]] + all_num_len[year_digit[3]] + 20 + all_num_len[bang_date_digit[0]] + 2 + all_num_len[bang_date_digit[1]] + 2 + all_bang_months_len[month2 - 1] + 2 + all_num_len[year_digit_bangla[0]] + all_num_len[year_digit_bangla[1]] + all_num_len[year_digit_bangla[2]] + 2] = all_num[year_digit_bangla[3]][p];

      pattern2[p + 2 + 2 + all_prohor_len[prohor] + 2 + all_num_len[eng_date_digit[0]] + 2 + all_num_len[eng_date_digit[1]] + 2 + all_eng_months_len[month - 1] + 2 + all_num_len[year_digit[0]] + all_num_len[year_digit[1]] + all_num_len[year_digit[2]] + all_num_len[year_digit[3]] + 20 + all_num_len[bang_date_digit[0]] + 2 + all_num_len[bang_date_digit[1]] + 2 + all_bang_months_len[month2 - 1] + 2 + all_num_len[year_digit_bangla[0]] + all_num_len[year_digit_bangla[1]] + all_num_len[year_digit_bangla[2]] + all_num_len[year_digit_bangla[3]] + 2 + slash_len + 2 + all_hijri_months_len[month3 - 1] + 4] = all_num[hijri_date_digit[0]][p];
      pattern2[p + 2 + 2 + all_prohor_len[prohor] + 2 + all_num_len[eng_date_digit[0]] + 2 + all_num_len[eng_date_digit[1]] + 2 + all_eng_months_len[month - 1] + 2 + all_num_len[year_digit[0]] + all_num_len[year_digit[1]] + all_num_len[year_digit[2]] + all_num_len[year_digit[3]] + 20 + all_num_len[bang_date_digit[0]] + 2 + all_num_len[bang_date_digit[1]] + 2 + all_bang_months_len[month2 - 1] + 2 + all_num_len[year_digit_bangla[0]] + all_num_len[year_digit_bangla[1]] + all_num_len[year_digit_bangla[2]] + all_num_len[year_digit_bangla[3]] + 2 + slash_len + 2 + all_hijri_months_len[month3 - 1] + 4 + all_num_len[hijri_date_digit[0]]] = all_num[hijri_date_digit[1]][p];

      pattern2[p + 2 + 2 + all_prohor_len[prohor] + 2 + all_num_len[eng_date_digit[0]] + 2 + all_num_len[eng_date_digit[1]] + 2 + all_eng_months_len[month - 1] + 2 + all_num_len[year_digit[0]] + all_num_len[year_digit[1]] + all_num_len[year_digit[2]] + all_num_len[year_digit[3]] + 20 + all_num_len[bang_date_digit[0]] + 2 + all_num_len[bang_date_digit[1]] + 2 + all_bang_months_len[month2 - 1] + 2 + all_num_len[year_digit_bangla[0]] + all_num_len[year_digit_bangla[1]] + all_num_len[year_digit_bangla[2]] + all_num_len[year_digit_bangla[3]] + 2 + slash_len + 2 + all_hijri_months_len[month3 - 1] + 4 + all_num_len[hijri_date_digit[0]] + all_num_len[hijri_date_digit[1]] + 2] = pattern_slash[p];
      
      pattern2[p + 2 + 2 + all_prohor_len[prohor] + 2 + all_num_len[eng_date_digit[0]] + 2 + all_num_len[eng_date_digit[1]] + 2 + all_eng_months_len[month - 1] + 2 + all_num_len[year_digit[0]] + all_num_len[year_digit[1]] + all_num_len[year_digit[2]] + all_num_len[year_digit[3]] + 20 + all_num_len[bang_date_digit[0]] + 2 + all_num_len[bang_date_digit[1]] + 2 + all_bang_months_len[month2 - 1] + 2 + all_num_len[year_digit_bangla[0]] + all_num_len[year_digit_bangla[1]] + all_num_len[year_digit_bangla[2]] + all_num_len[year_digit_bangla[3]] + 2 + slash_len + 2 + all_hijri_months_len[month3 - 1] + 4 + all_num_len[hijri_date_digit[0]] + all_num_len[hijri_date_digit[1]] + 2 + slash_len + 2] = all_num[year_digit_hijri[0]][p];
      pattern2[p + 2 + 2 + all_prohor_len[prohor] + 2 + all_num_len[eng_date_digit[0]] + 2 + all_num_len[eng_date_digit[1]] + 2 + all_eng_months_len[month - 1] + 2 + all_num_len[year_digit[0]] + all_num_len[year_digit[1]] + all_num_len[year_digit[2]] + all_num_len[year_digit[3]] + 20 + all_num_len[bang_date_digit[0]] + 2 + all_num_len[bang_date_digit[1]] + 2 + all_bang_months_len[month2 - 1] + 2 + all_num_len[year_digit_bangla[0]] + all_num_len[year_digit_bangla[1]] + all_num_len[year_digit_bangla[2]] + all_num_len[year_digit_bangla[3]] + 2 + slash_len + 2 + all_hijri_months_len[month3 - 1] + 4 + all_num_len[hijri_date_digit[0]] + all_num_len[hijri_date_digit[1]] + 2 + slash_len + 2 + all_num_len[year_digit_hijri[0]]] = all_num[year_digit_hijri[1]][p];
      pattern2[p + 2 + 2 + all_prohor_len[prohor] + 2 + all_num_len[eng_date_digit[0]] + 2 + all_num_len[eng_date_digit[1]] + 2 + all_eng_months_len[month - 1] + 2 + all_num_len[year_digit[0]] + all_num_len[year_digit[1]] + all_num_len[year_digit[2]] + all_num_len[year_digit[3]] + 20 + all_num_len[bang_date_digit[0]] + 2 + all_num_len[bang_date_digit[1]] + 2 + all_bang_months_len[month2 - 1] + 2 + all_num_len[year_digit_bangla[0]] + all_num_len[year_digit_bangla[1]] + all_num_len[year_digit_bangla[2]] + all_num_len[year_digit_bangla[3]] + 2 + slash_len + 2 + all_hijri_months_len[month3 - 1] + 4 + all_num_len[hijri_date_digit[0]] + all_num_len[hijri_date_digit[1]] + 2 + slash_len + 2 + all_num_len[year_digit_hijri[0]] + all_num_len[year_digit_hijri[1]]] = all_num[year_digit_hijri[2]][p];
      pattern2[p + 2 + 2 + all_prohor_len[prohor] + 2 + all_num_len[eng_date_digit[0]] + 2 + all_num_len[eng_date_digit[1]] + 2 + all_eng_months_len[month - 1] + 2 + all_num_len[year_digit[0]] + all_num_len[year_digit[1]] + all_num_len[year_digit[2]] + all_num_len[year_digit[3]] + 20 + all_num_len[bang_date_digit[0]] + 2 + all_num_len[bang_date_digit[1]] + 2 + all_bang_months_len[month2 - 1] + 2 + all_num_len[year_digit_bangla[0]] + all_num_len[year_digit_bangla[1]] + all_num_len[year_digit_bangla[2]] + all_num_len[year_digit_bangla[3]] + 2 + slash_len + 2 + all_hijri_months_len[month3 - 1] + 4 + all_num_len[hijri_date_digit[0]] + all_num_len[hijri_date_digit[1]] + 2 + slash_len + 2 + all_num_len[year_digit_hijri[0]] + all_num_len[year_digit_hijri[1]] + all_num_len[year_digit_hijri[2]]] = all_num[year_digit_hijri[3]][p];
    }
    if (p < 20)
    {
      pattern2[p + 2 + 2 + all_prohor_len[prohor] + 2 + all_num_len[eng_date_digit[0]] + 2 + all_num_len[eng_date_digit[1]] + 2 + all_eng_months_len[month - 1] + 2 + all_num_len[year_digit[0]] + all_num_len[year_digit[1]] + all_num_len[year_digit[2]] + all_num_len[year_digit[3]]] = pattern_slash[p];
      pattern2[p + 2 + 2 + all_prohor_len[prohor] + 2 + all_num_len[eng_date_digit[0]] + 2 + all_num_len[eng_date_digit[1]] + 2 + all_eng_months_len[month - 1] + 2 + all_num_len[year_digit[0]] + all_num_len[year_digit[1]] + all_num_len[year_digit[2]] + all_num_len[year_digit[3]] + 20 + all_num_len[bang_date_digit[0]] + 2 + all_num_len[bang_date_digit[1]] + 2 + all_bang_months_len[month2 - 1] + 2 + all_num_len[year_digit_bangla[0]] + all_num_len[year_digit_bangla[1]] + all_num_len[year_digit_bangla[2]] + all_num_len[year_digit_bangla[3]] + 2] = pattern_slash[p];
    }


    if (p < all_eng_months_len[month - 1])
    {
      pattern2[p + 2 + 2 + all_prohor_len[prohor] + 2 + all_num_len[eng_date_digit[0]] + 2 + all_num_len[eng_date_digit[1]] + 2] = all_eng_months[month - 1][p];
    }
    if (p < all_bang_months_len[month2 - 1])
    {
      pattern2[p + 2 + 2 + all_prohor_len[prohor] + 2 + all_num_len[eng_date_digit[0]] + 2 + all_num_len[eng_date_digit[1]] + 2 + all_eng_months_len[month - 1] + 2 + all_num_len[year_digit[0]] + all_num_len[year_digit[1]] + all_num_len[year_digit[2]] + all_num_len[year_digit[3]] + 20 + all_num_len[bang_date_digit[0]] + 2 + all_num_len[bang_date_digit[1]] + 2] = all_bang_months[month2 - 1][p];
    }
    if (p < all_hijri_months_len[month3 - 1])
    {
      pattern2[p + 2 + 2 + all_prohor_len[prohor] + 2 + all_num_len[eng_date_digit[0]] + 2 + all_num_len[eng_date_digit[1]] + 2 + all_eng_months_len[month - 1] + 2 + all_num_len[year_digit[0]] + all_num_len[year_digit[1]] + all_num_len[year_digit[2]] + all_num_len[year_digit[3]] + 20 + all_num_len[bang_date_digit[0]] + 2 + all_num_len[bang_date_digit[1]] + 2 + all_bang_months_len[month2 - 1] + 2 + all_num_len[year_digit_bangla[0]] + all_num_len[year_digit_bangla[1]] + all_num_len[year_digit_bangla[2]] + all_num_len[year_digit_bangla[3]] + 2 + slash_len + 2] = all_hijri_months[month3 - 1][p];
    }

    if (p < all_prohor_len[prohor])
    {
      pattern2[p + 2] = all_bang_prohors[prohor][p];
    }

  }



  /*
    int p;
    for(p=0;p<60;p++)
    pattern4[p]=0x00;
    for(p=0;p<128;p++)
    pattern3[p]=0x00;

    for(p=0;p<188;p++)
    pattern2[p]=0x00;

    int n;

    for(n=0;n<128;n++)
    {
    pattern3[n]=all_eng_months[month-1][n];
    }
    for(n=0;n<26;n++){
      pattern4[n]=all_num[eng_date_digit[0]][n];
      pattern4[n+28]=all_num[eng_date_digit[1]][n];
    }

    for(n=0;n<60;n++)
    {
    pattern2[n]=pattern4[n];
    }
    for(n=60;n<188;n++)
    {
    pattern2[n]=pattern3[n-60];
    }


  */


  ////////////TmStp();


  //uint16_t pattern1[] = {0x00, 0x00, 0x1c, 0x0e, 0x10, 0x0b, 0x30, 0x01, 0x20, 0x01, 0x20, 0x23, 0x20,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 0x20, 0x00};

  //uint16_t colon[] = {0x00, 0x00, 0x30, 0x0c, 0x30, 0x0c, 0x00, 0x00};



  int len2 = sizeof(pattern2) / sizeof(pattern2[0]);




  int col = 128;
  int j = 128;
  int i = 0;
  while (col <= 159)
  {
    ////////////TmStp();
    show_led_time();
    while (i + 128 <= j)
    {

      mx.setColumn(col - i, pattern2[2 * i]);
      mx.setColumn(col + 32 - i, pattern2[2 * i + 1]);
      i++;
    }
    ////////////TmStp();

    j++;
    i = 0;
    col = i + j;
  }
  ////////////TmStp();


  if (col > 159)
  {
    for ( int m = 0; m < len2 / 2 - 32; m++)
    {
      //////////TmStp();
      show_led_time();
      for ( int k = 0; k < 32; k++)
      {
        mx.setColumn(159 - k, pattern2[2 * (1 + k + m)]);
        mx.setColumn(159 + 32 - k, pattern2[2 * (1 + k + m) + 1]);
      }


    }

  }
  //////////TmStp();
  for ( int m = 31; m >= 0; m--)
  {
    //////////TmStp();
    show_led_time();
    for ( int k = 0; k < m; k++)
    {
      mx.setColumn(159 - k, pattern2[len2 - 62 + 2 * k + 2 * (31 - m)]);
      mx.setColumn(159 + 32 - k, pattern2[len2 - 62 + 2 * k + 2 * (31 - m) + 1]);
    }
    //////////TmStp();
    show_led_time();
    for ( int p = 0; p <= 31 - m; p++)
    {
      mx.setColumn(159 - m - p, 0x00);
      mx.setColumn(159 + 32 - m - p, 0x00);
    }
    //////////TmStp();
  }


}
